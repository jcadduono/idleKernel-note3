## arch/arm/configs/msm8610_sec_heat_usa_dyn_defconfig
```kconfig
CONFIG_SEC_HEAT_PROJECT=y
CONFIG_MACH_HEAT_DYN=y
# CONFIG_EXT_MAINMIC_BIAS is not set
CONFIG_EXT_SUBMIC_BIAS=y

CONFIG_SENSORS=y
CONFIG_PROXIMITY_SENSOR=y
CONFIG_SENSORS_GP2A002=y
CONFIG_SENSORS_BMA254=y
CONFIG_SENSORS_POWER_EN=y
CONFIG_SENSORS_POWERCONTROL=y

CONFIG_FB_MSM_MIPI_CMD_WVGA_ILI9806B_PT_PANEL=y

CONFIG_BACKLIGHT_CONTROL_DCS=y
CONFIG_LEDS_SEC_BACKLIGHT=y
CONFIG_MSM_VIBRATOR=y
```

## drivers/media/platform/msm/camera_v2/Kconfig
```kconfig
config MSM_CAMERA_SENSOR
	    bool "Qualcomm MSM camera sensor support"
	    depends on MSMB_CAMERA
	---help---
	  This flag enables support for Camera Sensor.
	  The sensor driver is capable of providing real time
	  data for camera support. The driver support V4L2
	  subdev APIs.

config MSM_CPP
	bool "Qualcomm MSM Camera Post Processing Engine support"
	depends on MSMB_CAMERA
	---help---
	  Enable support for Camera Post-processing Engine
	  The Post processing engine is capable of scaling
	  and cropping image. The driver support V4L2 subdev
	  APIs.

config MSM_CCI
	bool "Qualcomm MSM Camera Control Interface support"
	depends on MSMB_CAMERA
	---help---
	  Enable support for Camera Control Interface driver only
	  for those platforms that have hardware support. This driver
	  is responsible for handling I2C read and write on the I2C
	  bus. It is also responsible for synchronization with
	  GPIO and data frames.

config MSM_CSI20_HEADER
	bool "Qualcomm MSM CSI 2.0 Header"
	depends on MSMB_CAMERA
	---help---
	  Enable support for CSI drivers to include 2.0
	  header. This header has register macros and its
	  values and bit mask for register configuration bits
	  This config macro is required targets based on 8960,
	  8930 and 8064 platforms.

config MSM_CSI30_HEADER
	bool "Qualcomm MSM CSI 3.0 Header"
	depends on MSMB_CAMERA
	---help---
	  Enable support for CSI drivers to include 3.0
	  header. This header has register macros and its
	    values and bit mask for register configuration bits
	  This config macro is required for targets based on
	  8064 platforms.

config MSM_CSIPHY
	bool "Qualcomm MSM Camera Serial Interface Physical receiver support"
	depends on MSMB_CAMERA
	---help---
	  Enable support for Camera Serial Interface
	  Physical receiver. It deserializes packets and
	  supports detection of packet start and stop
	  signalling.

config MSM_CSID
	bool "Qualcomm MSM Camera Serial Interface decoder support"
	depends on MSMB_CAMERA
	---help---
	  Enable support for Camera Serial Interface decoder.
	  It supports lane merging and decoding of packets
	  based on cid which is mapped to a virtual channel
	  and datatype.

config MSM_EEPROM
	bool "Qualcomm MSM Camera ROM Interface for Calibration support"
	depends on MSMB_CAMERA
	---help---
	  Enable support for ROM Interface for Calibration
	  Provides interface for reading the Claibration data.
	  and also provides support for writing data in case of FLASH ROM.
	  Currently supports I2C, CCI and SPI protocol

config MSM_ISPIF
	bool "Qualcomm MSM Image Signal Processing interface support"
	depends on MSMB_CAMERA
	---help---
	  Enable support for Image Signal Processing interface module.
	  This module acts as a crossbar between CSID and VFE. Output
	  of any CID of CSID can be routed to of of pixel or raw
	  data interface in VFE.

config MSM_V4L2_VIDEO_OVERLAY_DEVICE
	tristate "Qualcomm MSM V4l2 video overlay device"
	---help---
	  Enables support for the MSM V4L2 video
	  overlay driver. This allows video rendering
	  apps to render overlaid video using Video4Linux2
	  APIs, by using /dev/videoX device

config MSMB_JPEG
	tristate "Qualcomm MSM Jpeg Encoder Engine support"
	depends on MSMB_CAMERA && (ARCH_MSM8974 || ARCH_MSM8226)
	---help---
	  Enable support for Jpeg Encoder/Decoder
	  Engine for 8974.
	  This module serves as the common driver
	  for the JPEG 1.0 encoder and decoder.
```

## drivers/media/platform/msm/vidc/Kconfig
```kconfig
#
# VIDEO CORE
#

menuconfig MSM_VIDC_V4L2
	bool "Qualcomm MSM V4L2 based video driver"
		depends on (ARCH_MSM8974 || ARCH_MSM8610 || ARCH_MSM8226) && VIDEO_V4L2

config MSM_VIDC_IGNORE_YUV
	bool "Ignore V4L2_MSM_BUF_FLAG_YUV_601_709_CLAMP flag"
	depends on MSM_VIDC_V4L2
	default n
	help
	  Say Y here to ignore the V4L2_MSM_BUF_FLAG_YUV_601_709_CLAMP
	  flag sent by Note 5 CameraService. This prevents the colorspace
	  from alternating rapidly when it isn't actually in use by the
	  hardware. Solution found by CekMTL.
```
